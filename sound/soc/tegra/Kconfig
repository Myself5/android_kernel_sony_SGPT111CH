## sound/soc/tegra/Kconfig
```kconfig
# 2011-06-10: File changed by Sony Corporation
config TEGRA_ALSA
    tristate "Tegra ALSA SoC support"
    select TEGRA_PCM
    select TEGRA_I2S
    select TEGRA_IEC
    select TEGRA_GENERIC_CODEC
    select TEGRA_JACK
    help
       Say Y if you for ALSA SoC support

config TEGRA_PCM
    tristate "Tegra ALSA pcm callbacks"

config TEGRA_I2S
    tristate "Tegra I2S"

config TEGRA_IEC
    tristate "Tegra IEC"

config TEGRA_GENERIC_CODEC
    tristate "Tegra ALSA Generic Codec support"

config TEGRA_JACK
    tristate "Tegra wired accessory jack support"

config SND_SOC_WM8903_CHSW 
    bool "channel switches by rotation" if SND_SOC_WM8903
    default n
    depends on SND_SOC_WM8903
    help
       switch speaker channel by rotation

config AUDIO_WORKAROUND
    bool "work around enable"
    default n
```
